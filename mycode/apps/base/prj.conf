## CMakeLists.txt
```
# SPDX-License-Identifier: Apache-2.0

cmake_minimum_required(VERSION 3.20.0)
find_package(Zephyr REQUIRED HINTS $ENV{ZEPHYR_BASE})
project(prac02)

FILE(GLOB app_sources src/*.c)

FILE(GLOB lib_sources lib/*.c)


target_sources(app PRIVATE ${app_sources} ${lib_sources})

target_include_directories(app PRIVATE include/)
```

## prj.conf
```kconfig
CONFIG_PRINTK=y
CONFIG_HEAP_MEM_POOL_SIZE=8192

CONFIG_BT=y
CONFIG_BT_OBSERVER=y

CONFIG_SHELL=y
```

## src/main.c
```c
#include <zephyr/kernel.h>
#include <zephyr/device.h>
#include <zephyr/shell/shell.h>
#include "process_packets.h"
#include "pathfinding.h"
#include "recieve.h"

/* size of stack area used by each thread */
#define STACKSIZE 1024

/* scheduling priority used by each thread */
#define PRIORITY 7


void send_json(void) {
    // get info from car_info queue
    // if obstacle detected, draw new path
    int count = 0;
    while (1) {
        // printk("json %d \n", count);
        count++;
        k_sleep(K_MSEC(200));
    }
}


K_THREAD_DEFINE(process_id, STACKSIZE * 5, processing, NULL, NULL, NULL, 5, 0, 0);
K_THREAD_DEFINE(json_id, STACKSIZE, send_json, NULL, NULL, NULL, 6, 0, 0);
K_THREAD_DEFINE(pathfinding_id, STACKSIZE * 4, draw_map, NULL, NULL, NULL, 7, 0, 0); // lower priority
K_THREAD_DEFINE(recieve_id, STACKSIZE * 5, recieve_packets, NULL, NULL, NULL, 4, 0, 0);

// route (x,y) (x,y) - defines the start and end point for path
static int cmd_get_map(const struct shell *sh, size_t argc, char **argv) {
    if (argc != 3) {
        shell_error(sh, "Invalid number of arguments");
        return 0;
    }

    char* start_str = argv[1];
    char* end_str = argv[2];

    int start_x, start_y, end_x, end_y;

    if (sscanf(start_str, "(%d,%d)", &start_x, &start_y) != 2 ||
        sscanf(end_str, "(%d,%d)", &end_x, &end_y) != 2) {
        shell_error(sh, "Invalid format for start or end point. Use (x,y)");
        return 0;
    }

    if (start_x < 0 || start_x >= ROWS || start_y < 0 || start_y >= COLUMNS ||
        end_x < 0 || end_x >= ROWS || end_y < 0 || end_y >= COLUMNS) {
        shell_error(sh, "Start or end point out of bounds");
        return 0;
    }

    start.x = start_x;
    start.y = start_y;
    end.x = end_x;
    end.y = end_y;
    kalman_init_x = start_x;
    kalman_init_y = start_y;
    printk("Start point set to (%d, %d)\n", start.x, start.y);
    printk("End point set to (%d, %d)\n", end.x, end.y);
    
    coords_given = 1;
    return 1;
}

// mode auto or mode man
static int cmd_get_mode(const struct shell *sh, size_t argc, char **argv) {
    if (argc != 2) {
        shell_error(sh, "Invalid number of arguments");
        return 0;
    }

    if (!strcmp(argv[1], "auto")) {
        mode = AUTO;
        printk("Auto mode enabled\n");
    } else if (!strcmp(argv[1], "man")) {
        mode = MANUAL;
        printk("Manual mode enabled\n");
    } else {
        shell_error(sh, "Invalid mode. Use 'auto' or 'man'");
        return 0;
    }
    return 1;
}

SHELL_CMD_ARG_REGISTER(route, NULL, "Defines the start and end point for path", cmd_get_map, 3, 3);
SHELL_CMD_ARG_REGISTER(mode, NULL, "Defines if car position is from input for rc car", cmd_get_mode, 2, 2);
```

## include/kalman.h
```c
#ifndef KALMAN_H
#define KALMAN_H

#include <zephyr/kernel.h>
#include <zephyr/device.h>
#include <math.h>
#include <stdio.h>

#define STATE_SIZE 4
#define NUM_MEAS 2

typedef struct {
    float transition[STATE_SIZE][STATE_SIZE]; // State transition matrix
    float measurement[NUM_MEAS][STATE_SIZE]; // Measurement matrix
    float state_vector[STATE_SIZE];  // estimated state vector
    float covariance[STATE_SIZE][STATE_SIZE]; // State covariance matrix
    float process_noise[STATE_SIZE][STATE_SIZE]; // Process noise covariance
    float measurement_noise[NUM_MEAS][NUM_MEAS]; // Measurement noise covariance

    float state_estimate[STATE_SIZE]; // Estimated state vector
    float covariance_estimate[STATE_SIZE][STATE_SIZE]; // Estimated covariance matrix
    float meas_error[NUM_MEAS]; // Measurement error
    float cov_error[NUM_MEAS][NUM_MEAS]; // Measurement covariance
    float kalman_gain[STATE_SIZE][NUM_MEAS]; // Kalman gain
} KalmanFilter;

extern void kalman_init(KalmanFilter *kf, float *x_init, float *cov_init, float meas_err, float proc_err, float dt);
extern void kalman_update(KalmanFilter *kf, float *obs);

#endif
```

## include/pathfinding.h
```c
#ifndef PATHFINDING_H
#define PATHFINDING_H

#define ROWS 6
#define COLUMNS 8
#define CELL_WIDTH 255 // mm
#define CELL_HEIGHT 255 // mm

#define M_PI 3.14159265358979323846f

#define NUM_NEIGHBORS 4

#define INF 999999999999

#define MANUAL 0
#define AUTO 1

struct point {
    int x;
    int y;
};

struct node {
    int x;
    int y;
    float final_weight;
    float path_weight;
    float heuristic_weight;
    struct node* parent;
    bool discovered;
    bool visited;
};

extern struct point start;
extern struct point end;
extern int coords_given;
extern int mode;

extern void draw_map(void);


#endif
```

## include/pqueue.h
```c
#ifndef PQUEUE_H
#define PQUEUE_H

#include <stdio.h>
#include <stdlib.h>
#include <string.h>
#include <zephyr/kernel.h>


typedef struct Entry {
    int priority;
    void* data;
} Entry;

typedef struct PQueue {
    Entry* entries;
    int num_items;
    int capacity;
} PQueue;

extern PQueue* init_pqueue();
extern void free_pqueue(PQueue* pqueue);
extern void resize_pqueue(PQueue* pqueue);
int get_parent(int index);
int get_left_child(int index);
int get_right_child(int index);
void swap_entries(Entry* a, Entry* b);
extern void insert_pqueue(PQueue* pqueue, int priority, void* data);
extern Entry remove_pqueue_min(PQueue* pqueue);
extern int get_pqueue_size(PQueue* pqueue);

#endif
```

## include/process_packets.h
```c
#ifndef PROCESS_PACKETS_H
#define PROCESS_PACKETS_H

#include <zephyr/kernel.h>
#include <zephyr/device.h>

#define WEST 0
#define NORTHWEST 1
#define NORTH 2
#define NORTHEAST 3
#define EAST 4

extern struct k_fifo car_info_queue;
extern struct k_fifo pathfinding_queue;

struct car_info {
    int obstacle_detected;
    int obstacle_dist;
    int obstacle_direction; // 0 = west, 1 = northwest, 2 = north, 3 = northeast, 4 = east
    float car_x;
    float car_y;
};

extern void processing(void);

struct car_info_data_item_t {
    void *fifo_reserved; /* 1st word reserved for use by FIFO */
    struct car_info data;
};

extern float kalman_init_x;
extern float kalman_init_y;

#endif
```

## include/recieve.h
```c
#ifndef RECIEVE_H
#define RECIEVE_H

#include <zephyr/kernel.h>
#include <zephyr/device.h>
#include <zephyr/bluetooth/bluetooth.h>
#include <zephyr/bluetooth/hci.h>
#include <zephyr/bluetooth/addr.h>
#include <math.h>

#define MOBILE_ADDR "C4:BC:8A:CE:12:70" 
#define SENSOR_ADDR "D9:C5:AF:3E:87:62" 
#define MOBILE_ADDR_TYPE "random"
#define SENSOR_ADDR_TYPE "random"

typedef struct packet_data {
	double displacement_x; // sensor
	double displacement_y;
	double mouse_x;
	double mouse_y;
	int obstacle_detected;
	double obstacle_dist;
	int obstacle_dir;
} packet_data;

extern struct k_fifo packets_queue;

struct data_item_t {
    void *fifo_reserved; /* 1st word reserved for use by FIFO */
    packet_data data;
};

extern void recieve_packets(void);

#endif
```
