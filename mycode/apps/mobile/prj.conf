## CMakeLists.txt
```
cmake_minimum_required(VERSION 3.20.0)
set(DTC_OVERLAY_FILE "~/csse4011/project/sisyphus-red/mycode/apps/mobile/boards/nrf52840dk_nrf52840.overlay")
find_package(Zephyr REQUIRED HINTS $ENV{ZEPHYR_BASE})

project(mobile)

FILE(GLOB app_sources src/*.c)

target_sources(app PRIVATE ${app_sources})
```

## prj.conf
```kconfig
# terminal
CONFIG_PRINTK=y
CONFIG_SHELL=y
CONFIG_LOG=y
CONFIG_LOG_DEFAULT_LEVEL=3
CONFIG_UART_CONSOLE=y
CONFIG_LOG_BACKEND_RTT=n
CONFIG_LOG_BACKEND_UART=n
CONFIG_SHELL_BACKEND_SERIAL=y

# bluetooth
CONFIG_BT=y
CONFIG_BT_OBSERVER=y
CONFIG_BT_BROADCASTER=y
CONFIG_BT_CENTRAL=y
CONFIG_BT_GATT_CLIENT=y
CONFIG_BT_GATT_AUTO_DISCOVER_CCC=y

# ultrasonic
CONFIG_LOG_MODE_DEFERRED=y
CONFIG_LOG_CMDS=y
CONFIG_GPIO=y
CONFIG_PWM=y
```

## src/main.c
```c
// header files
#include "mouse.h"
#include "integration.h"
#include "ultrasonic.h"

// main execution
int main(void)
{
    initialise_bluetooth();

    // create_integration_thread();
    create_mouse_thread();
    // create_ultrasonic_thread();
}
```

## src/integration.c
```c
// header file
#include "integration.h"

// integration thread
#define INTEGRATION_THREAD_STACKSIZE 1024
#define INTEGRATION_THREAD_PRIORITY 0
K_THREAD_STACK_DEFINE(integrationThreadStack, INTEGRATION_THREAD_STACKSIZE); 
struct k_thread integrationThreadData;

// logging
LOG_MODULE_REGISTER(info_integration, LOG_LEVEL_DBG); 

void initialise_bluetooth(void)
{
    int err;
	LOG_DBG("Initialisation in process");
	err = bt_enable(NULL);
	if (err) {
		LOG_ERR("Initialisation failed (err %d)", err);
		return;
	}
	LOG_DBG("Initialisation successful");
}

/*
 observes the bluetooth signals that are inputted to the mobile node.
 */
void integration_thread(void* arg1, void* arg2, void* arg3) 
{
    return;
}

void create_integration_thread(void)
{
    // integration thread
    k_thread_create(
        &integrationThreadData,                            // pointer to thread data structure
        integrationThreadStack,                            // stack area allocated for thread 
        K_THREAD_STACK_SIZEOF(integrationThreadStack),     // total size of stack
        integration_thread,                                         // thread function 
        NULL,                                           // arg 1
        NULL,                                           // arg 2
        NULL,                                           // arg 3
        INTEGRATION_THREAD_PRIORITY,                       // thread priority          
        0,                                              // thread options
        K_NO_WAIT                                       // start without waiting
    ); 
}
```

## src/integration.h
```c
#ifndef INTEGRATION_H
#define INTEGRATION_H
#endif

// c libraries
#include <stdio.h>
#include <stddef.h>
#include <stdlib.h>
#include <math.h>

// standard zephyr
#include <zephyr/init.h>
#include <zephyr/kernel.h> 
#include <zephyr/types.h>
#include <zephyr/sys/util.h>
#include <zephyr/device.h>
#include <zephyr/drivers/gpio.h>
#include <zephyr/drivers/sensor.h>

// terminal
#include <zephyr/shell/shell.h>
#include <zephyr/sys/printk.h>

// bluetooth
#include <zephyr/bluetooth/bluetooth.h>
#include <zephyr/bluetooth/gatt.h>
#include <zephyr/bluetooth/hci.h>
#include <zephyr/bluetooth/conn.h>
#include <zephyr/bluetooth/uuid.h>

extern void create_integration_thread(void);
extern void initialise_bluetooth(void);
```

## src/mouse.c
```c
// header file
#include "mouse.h"
#include "velocity_to_position.h"

// logging
LOG_MODULE_REGISTER(position_tracker, LOG_LEVEL_DBG); 

// semaphore
K_SEM_DEFINE(connectedSem, 0, 1);

#define MOUSE_ADDR "D1:00:02:1F:03:24 (random)"
static struct bt_uuid_16 my_hids_uuid = BT_UUID_INIT_16(0x1812);

// bluetooth structures
static struct bt_conn_cb conn_callbacks;
static const struct bt_le_conn_param *conn_params = BT_LE_CONN_PARAM_DEFAULT;
static struct bt_conn *default_conn = NULL;
static struct bt_conn *current_conn;
static struct bt_gatt_discover_params discover_params;
static uint16_t report_char_handle = 0;
static struct bt_gatt_subscribe_params subscribe_params;
static uint16_t hids_start_handle = 0, hids_end_handle = 0;

enum discover_stage {
    DISCOVER_STAGE_SERVICE,
    DISCOVER_STAGE_CHAR,
    DISCOVER_STAGE_CCC,
};

KalmanFilter2D kf;
float dt = 0.05; // 50 ms

static float last_x = 0.0f, last_y = 0.0f;
static float current_x = 0.0f, current_y = 0.0f;

static float prev_dx_mm = 0.0f, prev_dy_mm = 0.0f;
static float acceleration_x = 0.0f, acceleration_y = 0.0f;

static enum discover_stage discovery_stage = DISCOVER_STAGE_SERVICE;

volatile float current_x_mm = 0.0f;
volatile float current_y_mm = 0.0f;

#define DPI 1000
#define MM_PER_COUNT (25.4f / DPI)

#define SW0_NODE	DT_ALIAS(sw0)
static const struct gpio_dt_spec button = GPIO_DT_SPEC_GET_OR(SW0_NODE, gpios,
							      {0});
static struct gpio_callback button_cb_data;

// mouse thread
#define MOUSE_THREAD_STACKSIZE 2048
#define MOUSE_THREAD_PRIORITY 0
K_THREAD_STACK_DEFINE(mouseThreadStack, MOUSE_THREAD_STACKSIZE); 
struct k_thread mouseThreadData;

// Parameters you can tweak
#define BASE_SENSITIVITY 1.0f
#define ACCEL_THRESHOLD 10.0f   // counts per report
#define ACCEL_FACTOR 2.0f       // how much to multiply by at high speeds

struct PositionSender positionSender = {
    .xInt = 0,
    .xFrac = 0,
    .yInt = 0,
    .yFrac = 0
};

const struct bt_le_adv_param adv_params = {
    .options = BT_LE_ADV_OPT_USE_IDENTITY,
    .interval_min = 0x00A0,
    .interval_max = 0x00F0,
    .peer = NULL
};

float apply_acceleration(int8_t dx, int8_t dy, float dt_seconds) {
    float speed = sqrt(dx*dx + dy*dy) / dt_seconds;

    float scale = BASE_SENSITIVITY;

    if (speed > ACCEL_THRESHOLD) {
        scale *= ACCEL_FACTOR;
    }
    return scale;
}

void button_pressed(const struct device *dev, struct gpio_callback *cb,
		    uint32_t pins)
{
    current_x_mm = 0.0f;
    current_y_mm = 0.0f;
    last_x = 0.0f, last_y = 0.0f;
    current_x = 0.0f, current_y = 0.0f;

    prev_dx_mm = 0.0f, prev_dy_mm = 0.0f;
    acceleration_x = 0.0f, acceleration_y = 0.0f;

    positionSender.xInt = 0;
    positionSender.xFrac = 0;
    positionSender.yInt = 0;
    positionSender.yFrac = 0;

    reset_kalman_filter(&kf);
}

void initialise_button(void)
{
    int ret;

	if (!gpio_is_ready_dt(&button)) {
		printk("Error: button device %s is not ready\n",
		       button.port->name);
		return;
	}

	ret = gpio_pin_configure_dt(&button, GPIO_INPUT);
	if (ret != 0) {
		printk("Error %d: failed to configure %s pin %d\n",
		       ret, button.port->name, button.pin);
		return;
	}

	ret = gpio_pin_interrupt_configure_dt(&button,
					      GPIO_INT_EDGE_TO_ACTIVE);
	if (ret != 0) {
		printk("Error %d: failed to configure interrupt on %s pin %d\n",
			ret, button.port->name, button.pin);
		return;
	}

	gpio_init_callback(&button_cb_data, button_pressed, BIT(button.pin));
	gpio_add_callback(button.port, &button_cb_data);
	LOG_DBG("Set up button at %s pin %d\n", button.port->name, button.pin);
}

static void broadcast_position(void)
{
    uint8_t mfg_data[5];

    mfg_data[0] = 3; // MOUSE FLAG

    mfg_data[1] = positionSender.xInt;
    mfg_data[2] = positionSender.xFrac;
    mfg_data[3] = positionSender.yInt;
    mfg_data[4] = positionSender.yFrac;

    struct bt_data mobileAd[] = {
        BT_DATA(BT_DATA_MANUFACTURER_DATA, mfg_data, sizeof(mfg_data)),
    };

    int err; 

    err = bt_le_adv_start(&adv_params, mobileAd, ARRAY_SIZE(mobileAd),
                    NULL, 0);
    if (err) {
        LOG_ERR("Advertising failed to start (err %d)\n", err);
        return;
    }

    k_msleep(100);

    err = bt_le_adv_stop();
    if (err) {
        LOG_ERR("Advertising failed to stop (err %d)\n", err);
        return;
    }
}

static uint8_t notify_func(struct bt_conn *conn,
                           struct bt_gatt_subscribe_params *params,
                           const void *data, uint16_t length)
{
    if (!data) {
        LOG_ERR("Unsubscribed");
        return BT_GATT_ITER_STOP;
    }

    const uint8_t *report = (const uint8_t *)data;

    int8_t dx = (int8_t)report[1];
    int8_t dy = (int8_t)report[3];

    float dx_mm = dx * MM_PER_COUNT;
    float dy_mm = dy * MM_PER_COUNT;

    last_x = current_x;
    last_y = current_y;

    float vel[2] = {dx_mm, dy_mm};
    kalman2d_predict(&kf, vel);

    current_x = kf.state_vector[0];
    current_y = kf.state_vector[1];

    float predicted_x = last_x + dx_mm;
    float predicted_y = last_y + dy_mm;

    float tolerance_x = 2.0f * fabs(dx_mm) + 0.1f; // +0.1 mm base tolerance
    float tolerance_y = 2.0f * fabs(dy_mm) + 0.1f;

    if (fabs(current_x - predicted_x) > tolerance_x ||
        fabs(current_y - predicted_y) > tolerance_y) {
        printk("SANITY CHECK FAILED, SKIPPING THIS UPDATE\n");
        current_x = last_x;
        current_y = last_y;
        return BT_GATT_ITER_CONTINUE;
    }

    positionSender.xInt = (int) current_x;
    positionSender.xFrac = abs((int)((current_x - positionSender.xInt) * 1000));

    positionSender.yInt = (int) current_y;
    positionSender.yFrac = abs((int)((current_y - positionSender.yInt) * 1000));

    // broadcast_position();

    print_state(&kf);
    // printk("dx: %d, dy: %d\n", dx, dy);
    return BT_GATT_ITER_CONTINUE;
}


static uint8_t discover_func(struct bt_conn *conn,
                             const struct bt_gatt_attr *attr,
                             struct bt_gatt_discover_params *params)
{
    if (!attr) {
        LOG_INF("Discovery complete");
        return BT_GATT_ITER_STOP;
    }

    if (discovery_stage == DISCOVER_STAGE_SERVICE) {
        const struct bt_gatt_service_val *service = attr->user_data;

        if (!service) {
            LOG_WRN("Warning: attr->user_data is NULL at handle 0x%04x", attr->handle);
            return BT_GATT_ITER_CONTINUE;
        }

        if (bt_uuid_cmp(service->uuid, BT_UUID_HIDS) == 0) {
            LOG_INF("Found HID Service at handle range 0x%04x to 0x%04x",
                   attr->handle, service->end_handle);

            hids_start_handle = attr->handle + 1;
            hids_end_handle = service->end_handle;

            discovery_stage = DISCOVER_STAGE_CHAR;
            params->uuid = NULL;
            params->start_handle = hids_start_handle;
            params->end_handle = hids_end_handle;
            params->type = BT_GATT_DISCOVER_CHARACTERISTIC;

            int err = bt_gatt_discover(conn, params);
            if (err) {
                LOG_ERR("Characteristic discovery failed (err %d)", err);
                return BT_GATT_ITER_STOP;
            }

            return BT_GATT_ITER_STOP;
        }
    } 
    else if (discovery_stage == DISCOVER_STAGE_CHAR) {
        const struct bt_gatt_chrc *chrc = attr->user_data;

        if (!chrc) {
            LOG_WRN("Warning: attr->user_data is NULL during characteristic discovery at handle 0x%04x", attr->handle);
            return BT_GATT_ITER_CONTINUE;
        }

        if (bt_uuid_cmp(chrc->uuid, BT_UUID_HIDS_REPORT) == 0) {
            // Check if this characteristic supports Notify (input report)
            if (chrc->properties & BT_GATT_CHRC_NOTIFY) {
                report_char_handle = chrc->value_handle;
                LOG_DBG("Found HID Input Report Characteristic with Notify at handle: 0x%04x", report_char_handle);

                discovery_stage = DISCOVER_STAGE_CCC;
                params->uuid = BT_UUID_GATT_CCC;
                params->start_handle = attr->handle + 1;
                params->end_handle = hids_end_handle;
                params->type = BT_GATT_DISCOVER_DESCRIPTOR;

                int err = bt_gatt_discover(conn, params);
                if (err) {
                    LOG_ERR("CCC discovery failed (err %d)\n", err);
                    return BT_GATT_ITER_STOP;
                }

                return BT_GATT_ITER_STOP;
            }
        }
    } 
    else if (discovery_stage == DISCOVER_STAGE_CCC) {
        if (bt_uuid_cmp(attr->uuid, BT_UUID_GATT_CCC) == 0) {
            subscribe_params.notify = notify_func;
            subscribe_params.value_handle = report_char_handle;
            subscribe_params.ccc_handle = attr->handle;
            subscribe_params.value = BT_GATT_CCC_NOTIFY;

            int err = bt_gatt_subscribe(conn, &subscribe_params);
            if (err) {
                LOG_ERR("Subscribe failed (err %d)", err);
            } else {
                LOG_INF("Subscribed to HID input report notifications\n");
            }

            return BT_GATT_ITER_STOP;
        }
    }

    return BT_GATT_ITER_CONTINUE;
}

static void connected(struct bt_conn *conn, uint8_t err)
{
    if (err) {
        LOG_ERR("Failed to connect (err %u)", err);
        return;
    }
    LOG_INF("Connected to mouse");

    // // Zephyr example for 7.5–10 ms interval (fastest allowed by BLE spec)
    // static struct bt_le_conn_param fast_params = {
    //     .interval_min = 6,  // 7.5 ms (6 * 1.25 ms)
    //     .interval_max = 8,  // 10 ms (8 * 1.25 ms)
    //     .latency = 0,
    //     .timeout = 400,
    // };

    // int kc = bt_conn_le_param_update(conn, &fast_params);
    // if (kc) {
    //     LOG_ERR("Param update failed (err %d)", kc);
    // }

    // default_conn = bt_conn_ref(conn);


    LOG_INF("Starting GATT discovery...");

    current_conn = bt_conn_ref(conn);

    discover_params.func = discover_func;
    discover_params.start_handle = 0x0001;
    discover_params.end_handle = 0xffff;
    discover_params.type = BT_GATT_DISCOVER_PRIMARY;
    
    // BT_UUID_DECLARE_16(BT_UUID_HIDS_VAL);
    // discover_params.uuid = BT_UUID_HIDS;
    discover_params.uuid = &my_hids_uuid;

    k_sleep(K_MSEC(100));

    int rc = bt_gatt_discover(conn, &discover_params);
    if (rc) {
        LOG_ERR("Discover failed (err %d)", rc);
    }

    k_sem_give(&connectedSem);
}

static void disconnected(struct bt_conn *conn, uint8_t reason)
{
    LOG_ERR("Disconnected (reason %u)", reason);
}

int check_address_pattern(char* macAddress) {
    if (macAddress[0] != MOUSE_ADDR[0] || macAddress[1] != MOUSE_ADDR[1]) return 0;
    if (macAddress[2] != MOUSE_ADDR[2]) return 0;
    if (strcmp(&macAddress[5], &MOUSE_ADDR[5]) != 0) {
        return 0;
    }
    return 1;
}

void reception(const bt_addr_le_t *addr, int8_t rssi, uint8_t type,
			 struct net_buf_simple *ad)
{
    char addr_str[BT_ADDR_LE_STR_LEN];

	bt_addr_le_to_str(addr, addr_str, sizeof(addr_str));

    if ((type != BT_GAP_ADV_TYPE_ADV_IND) && (type != BT_GAP_ADV_TYPE_ADV_DIRECT_IND)) {
        return;
    }

    if (!check_address_pattern(addr_str)) {
        return;
    }

    bt_le_scan_stop();

    struct bt_conn *mouse_conn = NULL;

    int err = bt_conn_le_create(addr,
                                BT_CONN_LE_CREATE_CONN,
                                conn_params,
                                &mouse_conn);
    if (err) {
        LOG_ERR("Connection failed (err %d)", err);
    } else {
        LOG_INF("Connection initiated");
    }
}

void mouse_thread(void* arg1, void* arg2, void* arg3)
{
    // initialise_bluetooth();
    initialise_button();
    kalman2d_init(&kf, dt);

    conn_callbacks.connected = connected;
    conn_callbacks.disconnected = disconnected;
    bt_conn_cb_register(&conn_callbacks);

    struct bt_le_scan_param scan_param = {
		.type       = BT_LE_SCAN_TYPE_ACTIVE,
		.options    = BT_LE_SCAN_OPT_NONE,
		.interval   = BT_GAP_SCAN_FAST_INTERVAL,
		.window     = BT_GAP_SCAN_FAST_WINDOW,
	};
	int err;

	err = bt_le_scan_start(&scan_param, reception);
	if (err) {
		LOG_ERR("Start scanning failed (err %d)", err);
		return;
	}
	LOG_INF("Started scanning...\n");

    return;
}

void create_mouse_thread(void) 
{
    // mouse thread
    k_thread_create(
        &mouseThreadData,                            // pointer to thread data structure
        mouseThreadStack,                            // stack area allocated for thread 
        K_THREAD_STACK_SIZEOF(mouseThreadStack),     // total size of stack
        mouse_thread,                                         // thread function 
        NULL,                                           // arg 1
        NULL,                                           // arg 2
        NULL,                                           // arg 3
        MOUSE_THREAD_PRIORITY,                       // thread priority          
        0,                                              // thread options
        K_NO_WAIT                                       // start without waiting
    ); 
}
```

## src/mouse.h
```c
#ifndef MOUSE_H 
#define MOUSE_H 
#endif

// c libraries
#include <stdio.h>
#include <stddef.h>
#include <stdlib.h>
#include <math.h>

// standard zephyr
#include <zephyr/init.h>
#include <zephyr/kernel.h> 
#include <zephyr/types.h>
#include <zephyr/sys/util.h>
#include <zephyr/device.h>
#include <zephyr/drivers/gpio.h>
#include <zephyr/drivers/sensor.h>

// terminal
#include <zephyr/shell/shell.h>
#include <zephyr/sys/printk.h>

// bluetooth
#include <zephyr/bluetooth/bluetooth.h>
#include <zephyr/bluetooth/gatt.h>
#include <zephyr/bluetooth/hci.h>
#include <zephyr/bluetooth/conn.h>
#include <zephyr/bluetooth/uuid.h>

extern void create_mouse_thread(void);

struct PositionSender {
    int xInt;
    int xFrac;
    int yInt;
    int yFrac;
};

extern struct PositionSender positionSender;

extern struct k_sem connectedSem;
```

## src/ultrasonic.c
```c
/*
 * Ultrasonic ranger driver main source file
 * This file will run the ultrasonic sensor
 * 
 * Functionality:
 * - Utilise CLI to measure object distance from sensor
 * 
 * REF: 
 * https://github.com/zephyrproject-rtos/zephyr/tree/main/
 */
#include <zephyr/kernel.h>
#include <zephyr/device.h>
#include <zephyr/drivers/gpio.h>
#include <zephyr/drivers/pwm.h>
#include <zephyr/sys/printk.h>
#include <zephyr/shell/shell.h>
#include <zephyr/sys/ring_buffer.h>
#include <zephyr/logging/log.h>
#include <zephyr/bluetooth/bluetooth.h>
#include <zephyr/bluetooth/hci.h>

#include "mouse.h"
 
// Get the node identifiers using aliases
#define TRIGGER_NODE  DT_ALIAS(trigger)
#define ECHO_NODE1    DT_ALIAS(echo1)
#define SERVO_NODE    DT_ALIAS(servo)
 
#if !DT_NODE_HAS_STATUS(TRIGGER_NODE, okay)
#error "Trigger pin node is not okay"
#endif
 
#if !DT_NODE_HAS_STATUS(ECHO_NODE1, okay)
#error "Echo pin 1 node is not okay"
#endif

#if !DT_NODE_HAS_STATUS(SERVO_NODE, okay)
#error "Servo node is not okay"
#endif
 
// Get GPIO specs from device tree
static const struct gpio_dt_spec trig = GPIO_DT_SPEC_GET(TRIGGER_NODE, gpios);
static const struct gpio_dt_spec echo1 = GPIO_DT_SPEC_GET(ECHO_NODE1, gpios);
static const struct pwm_dt_spec servo = PWM_DT_SPEC_GET(SERVO_NODE);
 
#define PWM_PERIOD_NS 20000000  // 20ms (50Hz)
#define SERVO_MIN_PULSE_NS 1000000    
#define SERVO_MAX_PULSE_NS 2600000

#define WARNING_DIST 20 // Object warning distance
#define ULTRASONIC_FLAG 1 // For bluetooth transmission
 
// Thread stack size and priority
#define ULTRA_STACK_SIZE 2048
#define ULTRA_PRIORITY 5
#define SERVO_STACK_SIZE 2048
#define SERVO_PRIORITY 4
#define MAIN_STACK_SIZE 2048
#define MAIN_PRIORITY -1

static struct k_thread ultra_thread_data;
static struct k_thread servo_thread_data;
static struct k_thread main_thread_data;

K_THREAD_STACK_DEFINE(ultra_stack_area, ULTRA_STACK_SIZE);
static k_tid_t ultra_tid;

K_THREAD_STACK_DEFINE(servo_stack_area, SERVO_STACK_SIZE);
static k_tid_t servo_tid;

K_THREAD_STACK_DEFINE(main_stack_area, MAIN_STACK_SIZE);
static k_tid_t main_tid;

int angle;
int objectBool; 

// BLE Advertising params
const struct bt_le_adv_param adv_params_distance = {
     .options = BT_LE_ADV_OPT_USE_IDENTITY,
     .interval_min = 0x00A0,
     .interval_max = 0x00F0,
     .peer = NULL
};
 
LOG_MODULE_REGISTER(ultrasonic_node, LOG_LEVEL_DBG);  


 
// Broadcast distance (in centimeters)
void broadcast_distance(uint16_t objectBool, uint16_t distance_cm, uint16_t angle)
{
    uint8_t mfg_data[7];
    
    mfg_data[0] = (uint8_t)(objectBool & 0xFF);
    mfg_data[1] = (uint8_t)(distance_cm & 0xFF);
    mfg_data[2] = (uint8_t)(angle & 0xFF);

    mfg_data[3] = positionSender.xInt;
    mfg_data[4] = positionSender.xFrac;
    mfg_data[5] = positionSender.yInt;
    mfg_data[6] = positionSender.yFrac;
 
    struct bt_data ad[] = {
        BT_DATA(BT_DATA_MANUFACTURER_DATA, mfg_data, sizeof(mfg_data)),
    };
 
    int err = bt_le_adv_start(&adv_params_distance, ad, ARRAY_SIZE(ad), NULL, 0);
    if (err) {
        LOG_ERR("Advertising failed to start (err %d)\n", err);
        return;
    }
    
    k_msleep(200);

    err = bt_le_adv_stop();
    if (err) {
        LOG_ERR("Advertising failed to stop (err %d)\n", err);
    }
}
 
static void initialise_bluetooth(void)
{
    int err;
    LOG_DBG("Initialisation in process");
    err = bt_enable(NULL);
    if (err) {
        LOG_ERR("Initialisation failed (err %d)", err);
        return;
    }
    LOG_DBG("Initialisation successful");
}
 
// Convert angle (0–180°) to pulse width and set PWM
int servo_set_angle(uint8_t angle_deg)
{
    if (angle_deg > 180) {
        angle_deg = 180;
    }

    // Linear interpolation between min and max pulse widths
    uint32_t pulse_ns = SERVO_MIN_PULSE_NS +
        ((SERVO_MAX_PULSE_NS - SERVO_MIN_PULSE_NS) * angle_deg) / 180;

    return pwm_set_dt(&servo, PWM_PERIOD_NS, pulse_ns);
}

static void ultrasonic_init(void)
{
    if (!device_is_ready(trig.port) || 
        !device_is_ready(echo1.port) || 
        !device_is_ready(servo.dev)) {
        LOG_ERR("Error: One or more GPIO devices not ready\n");
        return;
    }

    gpio_pin_configure_dt(&trig, GPIO_OUTPUT_INACTIVE);
    gpio_pin_configure_dt(&echo1, GPIO_INPUT);

    // initialise_bluetooth();
}
 
static uint32_t ultrasonic_measure(const struct gpio_dt_spec *echo_pin)
{
    gpio_pin_set_dt(&trig, 1);
    k_busy_wait(10);
    gpio_pin_set_dt(&trig, 0);

    uint32_t timeout = k_cycle_get_32() + k_ms_to_cyc_ceil32(30);

    while (gpio_pin_get_dt(echo_pin) == 0) {
        if ((int32_t)(timeout - k_cycle_get_32()) <= 0) {
            return 0;
        }
    }

    uint32_t start = k_cycle_get_32();
    while (gpio_pin_get_dt(echo_pin) == 1) {
        if ((int32_t)(timeout - k_cycle_get_32()) <= 0) {
            return 0;
        }
    }

    uint32_t end = k_cycle_get_32();
    uint32_t cycles = end - start;
    uint64_t ns = k_cyc_to_ns_floor64(cycles);
    uint32_t time_us = ns / 1000;
    return time_us / 58;
}

void servo_thread(void *a, void *b, void *c)
{
    while (1) {
        // Sweep from 0° to 180°
        for (angle = 0; angle <= 180; angle += 15) {
            servo_set_angle(angle);
            k_msleep(500);
        }

        // Sweep from 180° back to 0°
        for (angle = 180; angle >= 0; angle -= 15) {
            servo_set_angle(angle);
            k_msleep(500);
        }

        k_msleep(100);
    }
}
 
void ultrasonic_thread(void *a, void *b, void *c)
{
    k_sem_take(&connectedSem, K_FOREVER);
    while (1) {
        uint32_t dist1 = ultrasonic_measure(&echo1);
        objectBool = 0;

        if (dist1 <= WARNING_DIST) {
            objectBool = 1;     
            if (objectBool) {
                printk("Obstacle near: %d cm at %d degrees\n", dist1, angle); 
            }
        } else {
            printk("Obstacle not close: %d cm at %d degrees\n", dist1, angle);
        }  
        broadcast_distance(objectBool, dist1, angle);   
    }
        
        k_msleep(500);
}
 
void start_ultrasonic_thread(void *a, void *b, void *c) {
    ultrasonic_init();

    ultra_tid = k_thread_create(&ultra_thread_data, ultra_stack_area,
                                 K_THREAD_STACK_SIZEOF(ultra_stack_area),
                                 ultrasonic_thread, NULL, NULL, NULL,
                                 ULTRA_PRIORITY, 0, K_NO_WAIT);
 
    servo_tid = k_thread_create(&servo_thread_data, servo_stack_area,
                            K_THREAD_STACK_SIZEOF(servo_stack_area),
                            servo_thread,
                            NULL, NULL, NULL,
                            SERVO_PRIORITY, 0, K_NO_WAIT);
}

void create_ultrasonic_thread(void) {
    main_tid = k_thread_create(&main_thread_data, main_stack_area,
                            K_THREAD_STACK_SIZEOF(main_stack_area),
                            start_ultrasonic_thread,
                            NULL, NULL, NULL,
                            MAIN_PRIORITY, 0, K_NO_WAIT);
}
 
// int main(void)
// {
//     main_tid = k_thread_create(&main_thread_data, main_stack_area,
//                             K_THREAD_STACK_SIZEOF(main_stack_area),
//                             start_ultrasonic_thread,
//                             NULL, NULL, NULL,
//                             MAIN_PRIORITY, 0, K_NO_WAIT);
//     LOG_INF("Ultrasonic sensor ready.\n");
 
//     return 0;
// }
 
```

## src/ultrasonic.h
```c
#ifndef ULTRASONIC_H 
#define ULTRASONIC_H 
#endif

#include <zephyr/kernel.h>
#include <zephyr/device.h>
#include <zephyr/drivers/gpio.h>
#include <zephyr/drivers/pwm.h>
#include <zephyr/sys/printk.h>
#include <zephyr/shell/shell.h>
#include <zephyr/sys/ring_buffer.h>
#include <zephyr/logging/log.h>
#include <zephyr/bluetooth/bluetooth.h>
#include <zephyr/bluetooth/hci.h>

extern void create_ultrasonic_thread(void);
```

## src/velocity_to_position.c
```c
#include "velocity_to_position.h"

#define PROCESS_NOISE 0.09f
#define ERROR_COVARIANCE 1.0f
#define MEASUREMENT_NOISE 1.0f

// Initialization
void kalman2d_init(KalmanFilter2D *kf, float dt) {
    memset(kf, 0, sizeof(KalmanFilter2D));
    // State transition (A)
    kf->transition[0][0] = 1.0f;
    kf->transition[1][1] = 1.0f;

    // Control (B)
    kf->control_matrix[0][0] = dt;
    kf->control_matrix[1][1] = dt;

    // Error covariance (P)
    for (int i = 0; i < STATE_SIZE; i++)
        kf->error_covariance[i][i] = ERROR_COVARIANCE;

    // Process noise (Q)
    for (int i = 0; i < STATE_SIZE; i++)
        kf->process_noise[i][i] = PROCESS_NOISE;

    // Measurement noise (R)
    for (int i = 0; i < MEASUREMENT_SIZE; i++)
        kf->measurement_noise[i][i] = MEASUREMENT_NOISE;
}

// Only prediction step (position update from velocity)
void kalman2d_predict(KalmanFilter2D *kf, float *vel) {
    float temp[STATE_SIZE] = {0};
    // x' = A * x + B * u
    for (int i = 0; i < STATE_SIZE; ++i) {
        for (int j = 0; j < STATE_SIZE; ++j)
            temp[i] += kf->transition[i][j] * kf->state_vector[j];
        for (int j = 0; j < CONTROL_SIZE; ++j)
            temp[i] += kf->control_matrix[i][j] * vel[j];
    }
    memcpy(kf->state_vector, temp, sizeof(float) * STATE_SIZE);
}

void print_floats(const char *label, float f) {
    int whole = (int)f;
    int frac = (int)((f - whole) * 1000); // 3 decimal places
    if (frac < 0) frac = -frac; // Ensure positive fraction

    printk("%s%d.%03d", label, whole, frac);
}

void reset_kalman_filter(KalmanFilter2D *kf)
{
    for (int i = 0; i < STATE_SIZE; ++i)
        kf->state_vector[i] = 0.0f;
    for (int i = 0; i < STATE_SIZE; ++i)
        for (int j = 0; j < STATE_SIZE; ++j)
            kf->error_covariance[i][j] = (i == j) ? 1.0f : 0.0f;
}


void print_state(const KalmanFilter2D *kf) 
{
    print_floats("", kf->state_vector[0]);
    printk(", ");
    print_floats("", kf->state_vector[1]);
    printk("\n");
}
```

## src/velocity_to_position.h
```c
#ifndef VELOCITY_TO_POSITION_H
#define VELOCITY_TO_POSITION_H
#endif

#include <string.h>
#include <math.h>
#include <zephyr/sys/printk.h>

#define STATE_SIZE 2
#define CONTROL_SIZE 2
#define MEASUREMENT_SIZE 2

typedef struct {
    float state_vector[STATE_SIZE];                  // [x, y]
    float error_covariance[STATE_SIZE][STATE_SIZE];  // P
    float transition[STATE_SIZE][STATE_SIZE];        // A
    float control_matrix[STATE_SIZE][CONTROL_SIZE];  // B
    float process_noise[STATE_SIZE][STATE_SIZE];     // Q
    float measurement_noise[MEASUREMENT_SIZE][MEASUREMENT_SIZE]; // R
} KalmanFilter2D;

extern void kalman2d_init(KalmanFilter2D *kf, float dt);
extern void reset_kalman_filter(KalmanFilter2D *kf);
```
